## main-board/components/LoRa/Kconfig
```kconfig
menu "LoRa Module"

    config LORA_UART_NUM
        int "UART port number"
        range 0 2
        default 1

    config LORA_TX_PIN
        int "TX GPIO pin"
        range 0 48
        default 17

    config LORA_RX_PIN
        int "RX GPIO pin"
        range 0 48
        default 18

    config LORA_AUX_PIN
        int "AUX GPIO pin"
        range 0 48
        default 19

    config LORA_BAUD
        int "Baud rate"
        default 9600

endmenu
```

## main-board/components/buzzer/Kconfig
```kconfig
menu "Buzzer Configuration"

    config BUZZER_GPIO_PIN
        int "Buzzer GPIO pin"
        range 0 48
        default 6
        help
            GPIO pin connected to the buzzer. Active low.

endmenu
```

## main-board/components/gps/Kconfig
```kconfig
menu "GPS Module"

    config GPS_UART_NUM
        int "UART port number"
        range 0 2
        default 2

    config GPS_TX_PIN
        int "TX GPIO pin"
        range 0 48
        default 20

    config GPS_RX_PIN
        int "RX GPIO pin"
        range 0 48
        default 21

    config GPS_BAUD
        int "Baud rate"
        default 9600

endmenu
```

## main-board/components/lcd12864/Kconfig
```kconfig
menu "LCD12864 Configuration"
    config LCD12864_PIN_SCLK
        int "SCLK Pin"
        default 46
        help
            GPIO number for SPI clock (SCLK).

    config LCD12864_PIN_SDA
        int "SDA (MOSI) Pin"
        default 45
        help
            GPIO number for SPI data (MOSI).

    config LCD12864_PIN_RS
        int "RS (DC) Pin"
        default 42
        help
            GPIO number for Register/Data selection (DC/A0).

    config LCD12864_PIN_CS
        int "CS Pin"
        default 15
        help
            GPIO number for Chip Select (CS). Active low.

    config LCD12864_PIN_RESET
        int "RESET Pin"
        default 41
        help
            GPIO number for Reset (RST). Active low.

    config LCD12864_SPI_CLOCK_HZ
        int "SPI Clock Speed (Hz)"
        default 1000000
        help
            SPI clock frequency in Hz. Typical values: 1000000 (1 MHz), 4000000 (4 MHz).
endmenu
```

## main-board/components/ld2402/Kconfig
```kconfig
menu "LD2402 Radar Sensor"

    config LD2402_IO_PIN
        int "IO output GPIO pin"
        range 0 48
        default 2
        help
            GPIO pin connected to the LD2402 IO output.
            High = person detected, Low = no person.

endmenu
```
